#include "oled_display.h"

#include "i2c.h"

#include <string.h>

#define OLED_I2C_ADDR_PRIMARY    0x78U
#define OLED_I2C_ADDR_SECONDARY  0x7AU
#define OLED_CONTROL_CMD         0x00U
#define OLED_CONTROL_DATA        0x40U
#define OLED_COLUMN_OFFSET       0U
#define OLED_CHUNK_DATA_LEN      16U

static const uint8_t k_oled_font_5x7[95][5] =
{
  {0x00, 0x00, 0x00, 0x00, 0x00}, {0x00, 0x00, 0x5F, 0x00, 0x00},
  {0x00, 0x07, 0x00, 0x07, 0x00}, {0x14, 0x7F, 0x14, 0x7F, 0x14},
  {0x24, 0x2A, 0x7F, 0x2A, 0x12}, {0x23, 0x13, 0x08, 0x64, 0x62},
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  {0x10, 0x08, 0x08, 0x10, 0x08}
};

static uint8_t g_oled_ready = 0U;
static uint8_t g_oled_addr = OLED_I2C_ADDR_PRIMARY;
static uint8_t g_oled_buffer[OLED_DISPLAY_WIDTH * OLED_DISPLAY_PAGE_COUNT];

static HAL_StatusTypeDef OledDisplay_WriteCommand(uint8_t command)
{
  uint8_t packet[2];

  packet[0] = OLED_CONTROL_CMD;
  packet[1] = command;
  return HAL_I2C_Master_Transmit(&hi2c1, g_oled_addr, packet, 2U, 20U);
}

static HAL_StatusTypeDef OledDisplay_WriteData(const uint8_t *data, uint16_t length)
{
  uint8_t packet[1U + OLED_CHUNK_DATA_LEN];
  uint16_t offset = 0U;

  if (data == NULL)
  {
    return HAL_ERROR;
  }

  packet[0] = OLED_CONTROL_DATA;
  while (offset < length)
  {
    uint16_t chunk_len = (uint16_t)(length - offset);
    if (chunk_len > OLED_CHUNK_DATA_LEN)
    {
      chunk_len = OLED_CHUNK_DATA_LEN;
    }

    memcpy(&packet[1], &data[offset], chunk_len);
    if (HAL_I2C_Master_Transmit(&hi2c1, g_oled_addr, packet, (uint16_t)(chunk_len + 1U), 20U) != HAL_OK)
    {
      return HAL_ERROR;
    }

    offset = (uint16_t)(offset + chunk_len);
  }

  return HAL_OK;
}

static void OledDisplay_DrawChar(uint8_t x, uint8_t line, char ch)
{
  uint8_t font_index;
  uint8_t column;
  uint16_t buffer_index;

  if ((line >= OLED_DISPLAY_PAGE_COUNT) || (x >= OLED_DISPLAY_WIDTH))
  {
    return;
  }

  if ((ch < 32) || (ch > 126))
  {
    ch = '?';
  }

  font_index = (uint8_t)(ch - 32);
  buffer_index = (uint16_t)(((uint16_t)line * OLED_DISPLAY_WIDTH) + x);

  for (column = 0U; column < 5U; ++column)
  {
    if ((x + column) < OLED_DISPLAY_WIDTH)
    {
      g_oled_buffer[buffer_index + column] = k_oled_font_5x7[font_index][column];
    }
  }

  if ((x + 5U) < OLED_DISPLAY_WIDTH)
  {
    g_oled_buffer[buffer_index + 5U] = 0x00U;
  }
}

uint8_t OledDisplay_Init(void)
{
  static const uint8_t k_init_cmds[] =
  {
    0xAE, 0xD5, 0x80, 0xA8, 0x3F, 0xD3, 0x00, 0x40,
    0x8D, 0x14, 0x20, 0x02, 0xA1, 0xC8, 0xDA, 0x12,
    0x81, 0xCF, 0xD9, 0xF1, 0xDB, 0x40, 0xA4, 0xA6,
    0x2E, 0xAF
  };
  uint8_t index;

  g_oled_ready = 0U;
  g_oled_addr = OLED_I2C_ADDR_PRIMARY;

  if (HAL_I2C_IsDeviceReady(&hi2c1, OLED_I2C_ADDR_PRIMARY, 2U, 20U) != HAL_OK)
  {
    if (HAL_I2C_IsDeviceReady(&hi2c1, OLED_I2C_ADDR_SECONDARY, 2U, 20U) != HAL_OK)
    {
      return 0U;
    }

    g_oled_addr = OLED_I2C_ADDR_SECONDARY;
  }

  for (index = 0U; index < sizeof(k_init_cmds); ++index)
  {
    if (OledDisplay_WriteCommand(k_init_cmds[index]) != HAL_OK)
    {
      return 0U;
    }
  }

  g_oled_ready = 1U;
  OledDisplay_Clear();
  OledDisplay_Update();
  return 1U;
}

uint8_t OledDisplay_IsReady(void)
{
  return g_oled_ready;
}

void OledDisplay_Clear(void)
{
  memset(g_oled_buffer, 0, sizeof(g_oled_buffer));
}

void OledDisplay_PrintLine(uint8_t line, const char *text)
{
  uint8_t x = 0U;
  uint16_t base_index;

  if ((line >= OLED_DISPLAY_PAGE_COUNT) || (text == NULL))
  {
    return;
  }

  base_index = (uint16_t)((uint16_t)line * OLED_DISPLAY_WIDTH);
  memset(&g_oled_buffer[base_index], 0, OLED_DISPLAY_WIDTH);

  while ((*text != '\0') && ((x + 5U) < OLED_DISPLAY_WIDTH))
  {
    OledDisplay_DrawChar(x, line, *text);
    x = (uint8_t)(x + 6U);
    text++;
  }
}

void OledDisplay_Update(void)
{
  uint8_t page;

  if (g_oled_ready == 0U)
  {
    return;
  }

  for (page = 0U; page < OLED_DISPLAY_PAGE_COUNT; ++page)
  {
    (void)OledDisplay_WriteCommand((uint8_t)(0xB0U + page));
    (void)OledDisplay_WriteCommand((uint8_t)(0x00U + (OLED_COLUMN_OFFSET & 0x0FU)));
    (void)OledDisplay_WriteCommand((uint8_t)(0x10U + ((OLED_COLUMN_OFFSET >> 4) & 0x0FU)));
    (void)OledDisplay_WriteData(&g_oled_buffer[page * OLED_DISPLAY_WIDTH], OLED_DISPLAY_WIDTH);
  }
}
